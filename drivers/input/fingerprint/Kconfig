## drivers/input/fingerprint/Kconfig
```kconfig
menuconfig INPUT_FINGERPRINT
        bool "Fingerprint devices"
        help
          Say y here to enable fingerprint driver support.

          If unsure, say Y.

if INPUT_FINGERPRINT

source "drivers/input/fingerprint/fpc/Kconfig"
source "drivers/input/fingerprint/goodix/Kconfig"

endif
```

## drivers/input/fingerprint/fpc/Kconfig
```kconfig
config FINGERPRINT_FPC1020
    tristate "FPC 1020 fingerprint support"
    depends on INPUT_FINGERPRINT
    help
      say Y here to enable support for FPC fingerprint sensor.
      
      If unsure, say Y.
      
      To compile this driver as a module, choose M here.
```

## drivers/input/fingerprint/goodix/Kconfig
```kconfig
config FINGERPRINT_GOODIX_FOD
	tristate "Goodix (FOD) fingerprint support"
	depends on INPUT_FINGERPRINT
	help
	  Say Y here to enable support for a goodix fingerprint sensor.

	  If unsure, say Y.

	  To compile this driver as a module, choose M here.

config FINGERPRINT_FP_VREG_CONTROL
	bool "Goodix fp_vdd_reg regulator control"
	depends on FINGERPRINT_GOODIX_FOD
	default n
	help
	  Say Y here to enable fp_vdd_vreg regulator by device driver
```

## drivers/media/platform/msm/Kconfig
```kconfig
# SPDX-License-Identifier: GPL-2.0-only

source "drivers/media/platform/msm/synx/Kconfig"
source "drivers/media/platform/msm/npu/Kconfig"
source "drivers/media/platform/msm/npu_v2/Kconfig"
```
